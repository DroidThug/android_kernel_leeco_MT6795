## drivers/input/fingerprint/Kconfig
```kconfig
#
#Fingerprint
#
menu "Finger support"
	depends on !UML

config MTK_FINGERPRINT
	tristate "Mediatek Fingerprint"
	default y
	---help---
	Fingerprint mtk driver enable/disable in the kernel.
	Say Y here if you want to use mediatek fingerprint driver,
	fingerprint driver will support fingerprint function in REE,
	it supports Goodix's GF316M/GF318M/GF3118M/GF518M/GF5118M/GF516M/GF816M/GF3208/GF5216... device.

if MTK_FINGERPRINT

config GOODIX_FINGERPRINT
	tristate "Goodix Fingerprint"
	default y
	---help---
	Goodix Fingerprint chip GF316M/GF318M/GF3118M/GF518M/GF5118M/GF516M/GF816M/GF3208/GF5216 TEE driver

config GOODIX_SENSOR_TYPE
	string "SENSOR_TYPE"
	default "GF518M"
	---help---
	Must input sensor type, or default is GF316M GF318M GF3118M GF518M GF5118M GF516M GF816M GF3208 GF5216

endif
endmenu
```

## drivers/misc/mediatek/video/Kconfig
```kconfig
config MTK_VIDEO
  bool CONFIG_MTK_VIDEO
  default n
  help
    CONFIG_MTK_VIDEO

config MTK_VIDEOX_CYNGN_LIVEDISPLAY
	bool CONFIG_MTK_VIDEOX_CYNGN_LIVEDISPLAY
	default n
	help
		Enable the RGB interface for color calibration.
```
